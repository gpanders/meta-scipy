## conf/layer.conf
```bitbake
# We have a conf and classes directory, add to BBPATH
BBPATH .= ":${LAYERDIR}"

# We have recipes-* directories, add to BBFILES
BBFILES += "${LAYERDIR}/recipes-*/*/*.bb \
            ${LAYERDIR}/recipes-*/*/*.bbappend"

BBFILE_COLLECTIONS += "meta-scipy"
BBFILE_PATTERN_meta-scipy = "^${LAYERDIR}/"
BBFILE_PRIORITY_meta-scipy = "6"

LAYERDEPENDS_meta-scipy = "core openembedded-layer meta-python"
LAYERSERIES_COMPAT_meta-scipy = "warrior thud zeus dunfell"
```
